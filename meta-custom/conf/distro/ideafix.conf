## meta-custom/conf/distro/ideafix.conf
```bitbake
# Distro settings
DISTRO = "ideafix"
DISTRO_NAME = "Ideafix (Linux OS based on Poky. Best friend of the Gaul Village of the embedded community)"
DISTRO_VERSION = "1.0"
DISTRO_CODENAME = "kirkstone"
MAINTAINER = "Gonzalo Matarrubia Gonzalez <g.matarrubia@gmail.com>"
hostname:pn-base-files = "homeassistant"
IMAGE_LINGUAS = "es-ES"

# SDK configs
SDK_VENDOR = "-pokysdk"
SDK_VERSION = "${@d.getVar('DISTRO_VERSION').replace('snapshot-${METADATA_REVISION}', 'snapshot')}"
SDK_VERSION[vardepvalue] = "${SDK_VERSION}"

LINUX_KERNEL_TYPE = "preempt-rt"

# Distro features
DISTRO_FEATURES:remove = "sysvinit x11"
DISTRO_FEATURES:append = " usbhost pam systemd virtualization wifi security bluetooth seccomp"
DISTRO_FEATURES_BACKFILL_CONSIDERED = ""

# Init manager configs
INIT_MANAGER = "systemd"
VIRTUAL-RUNTIME:init_manager = "systemd"
VIRTUAL-RUNTIME:initscripts = ""

UBOOT_EXTLINUX = "1"
UBOOT_EXTLINUX_ROOT = "${cbootargs} root=/dev/mmcblk0p1 rw rootwait"
```

## meta-custom/conf/distro/include/config-file.conf
```bitbake
# Settings set in config.txt file
# This is an important file for tuning RPI

#CMDLINE_DEBUG = "quiet"
TEGRA_BOARDREV ?= "B.4"

#GPU_MEM = "256"

#DISPMANX_OFFLINE = "1"
#DISABLE_OVERSCAN = "1"
#DISABLE_RPI_BOOT_LOGO = "1"
#DISABLE_SPLASH = "1"

#ENABLE_SPI_BUS = "1"
#ENABLE_I2C = "1"
#ENABLE_UART = "1"
#ENABLE_DWC2_PERIPHERAL = "0"
#SERIAL_CONSOLES = "115200;ttyS0"

#KERNEL_MODULE_AUTOLOAD:rpi += "i2c-dev"
# KERNEL_MODULE_AUTOLOAD:rpi += "i2c-dev i2c-bcm2708"
```

## meta-custom/conf/layer.conf
```bitbake
# We have a conf and classes directory, append to BBPATH
BBPATH .= ":${LAYERDIR}"

# We have a recipes directory containing .bb and .bbappend files, add to BBFILES
BBFILES += "${LAYERDIR}/recipes*/*/*.bb \
            ${LAYERDIR}/recipes*/*/*.bbappend"

BBFILE_COLLECTIONS += "custom"
BBFILE_PATTERN_custom := "^${LAYERDIR}/"
BBFILE_PRIORITY_custom = "9"

LAYERSERIES_COMPAT_custom = "kirkstone"


# Most dependencies come from the meta-python layer
LAYERDEPENDS_homeassistant = "homeassistant"
```

## meta-custom/conf/machine/custom-jetson-nano-nvme.conf
```bitbake
require ${SOURCES_DIR}/meta-tegra/conf/machine/jetson-orin-nano-devkit-nvme.conf
require custom-jetson-nano-common.inc

MACHINEOVERRIDES:append = ":jetson-orin-nano-devkit-nvme"
```

## meta-custom/conf/machine/custom-jetson-nano-sd.conf
```bitbake
require ${SOURCES_DIR}/meta-tegra/conf/machine/jetson-orin-nano-devkit.conf
#require ${SOURCES_DIR}/meta-tegra/conf/machine/jetson-nano-devkit.conf

require custom-jetson-nano-common.inc

MACHINEOVERRIDES:append = ":jetson-orin-nano-devkit"
#MACHINEOVERRIDES:append = ":jetson-nano-devkit"
```
